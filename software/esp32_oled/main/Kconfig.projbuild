## software/esp32_oled/main/Kconfig.projbuild
```kconfig
menu "Quad sensor display"
    config QUAD_OLED_SCL
        int "OLED SCL GPIO"
        default 5
        range 0 48
    config QUAD_OLED_SDA
        int "OLED SDA GPIO"
        default 6
        range 0 48
    config QUAD_LINK_RX
        int "STM32 link RX GPIO (STM32 PA2)"
        default 18
        range 0 48
    config QUAD_LINK_TX
        int "STM32 link TX GPIO (STM32 PA3)"
        default 17
        range 0 48
    config QUAD_LINK_BAUD
        int "STM32 link baud rate"
        default 115200
endmenu

menu "Quad phone controller"
    config QUAD_AP_SSID
        string "Controller Wi-Fi name"
        default "QUAD-CONTROL"
    config QUAD_AP_PASSWORD
        string "Controller Wi-Fi password (8-63 characters)"
        default "quad-phone-2026"
endmenu

menu "Quad STM32 A/B OTA"
    config QUAD_OTA_ENABLE
        bool "Enable automatic STM32 updates from Raspberry Pi"
        default n
    config QUAD_OTA_POLL_SECONDS
        int "Version check interval (seconds)"
        default 5
        range 1 3600
        help
            Delay between completed update checks. Network timeouts and an
            ongoing upgrade may make the actual interval longer.
    config QUAD_OTA_WIFI_SSID
        string "Router SSID"
        default ""
    config QUAD_OTA_WIFI_PASSWORD
        string "Router password"
        default ""
    config QUAD_OTA_MANIFEST
        string "Raspberry Pi manifest URL"
        default "http://192.168.1.100:8000/manifest.json"
endmenu
```

## software/esp32_oled/sdkconfig.defaults
```kconfig
CONFIG_IDF_TARGET="esp32s3"
CONFIG_QUAD_AP_SSID="QUAD-CONTROL"
CONFIG_QUAD_AP_PASSWORD="quad-phone-2026"
```
